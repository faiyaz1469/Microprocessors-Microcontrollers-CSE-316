#define F_CPU 1000000
#include <avr/io.h>
#include <util/delay.h>
#include <avr/interrupt.h>

char col[]={
	 1,2,4,8,16,32,64,128
	 };

char row[][8]={
         
		  {   0b11111111,
	          0b11000011,
	          0b10111101,
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			0b11111111,
			0b11111111} 
};
int cliflag = 0b00000000;

ISR(INT2_vect)
{
	cliflag = cliflag ^ 0b00000001;
}

int main(void)
{    
	MCUCSR = (1<<JTD);
	MCUCSR = (1<<JTD);
	
	DDRD = 0xFF;
	DDRC = 0xFF;
	
	DDRB=0;			
	PORTB=0xFF;		
	
	int i=0,j=0,k=0;
	GICR = 1<<INT2;		          /* Enable INT2*/
	MCUCSR = MCUCSR & 0b10111111; /*Falling Edge*/
   
	while (1) 
    {
		sei();
		if(cliflag == 1)
		{
			for(k=0;k<1120;k++)
			{
				PORTD = col[i];
				PORTC = row[j][i];
				_delay_ms(0.225);
				i += 1;
				if (i>7)
				  i=0;
			}
			
			 j+=1;
			 if(j>7)
			    j=0;
		}

		else 
		{
			for(k=0;k<1120;k++)
			{
				PORTD = col[i];
				PORTC = row[j][i];
				_delay_ms(0.225);
				i += 1;
				 if (i>7)
				   i=0;
			}
			
		}
		
	}
}

